## sdkconfig.defaults
```kconfig
# 表情播放器需要的 Kconfig 选项。
# 这些和你现有 sdkconfig 一致（目标、16MB、分区表、Octal PSRAM），
# 单独放在 defaults 里是为了：即便删掉 sdkconfig 重新生成，这些关键项也不会丢。

# ---- 芯片 / 存储 / 分区（与你现有 sdkconfig 一致，防重建丢失）----
CONFIG_IDF_TARGET="esp32s3"
CONFIG_ESPTOOLPY_FLASHSIZE_16MB=y
CONFIG_PARTITION_TABLE_CUSTOM=y
CONFIG_PARTITION_TABLE_CUSTOM_FILENAME="partitions-16MiB.csv"
CONFIG_SPIRAM=y
CONFIG_SPIRAM_MODE_OCT=y
CONFIG_SPIRAM_SPEED_80M=y

# ---- 表情播放器特有 ----
# esp_mmap_assets：资源包内文件名最大长度。你的包里最长是 16 字符的
# "smile_static.eaf"，默认值可能截断，所以放宽到 32。
CONFIG_MMAP_FILE_NAME_LENGTH=32

# LVGL 8 大字库格式（esp_emote_gfx 的提示标签字体用，对齐官方 test_apps）。
CONFIG_LV_FONT_FMT_TXT_LARGE=y

# main 任务栈加大一点，挂载资源包解析 index.json 时更稳。
CONFIG_ESP_MAIN_TASK_STACK_SIZE=8192
```
